/**
 * blender_ternary.c — Visualización 3D con Blender
 * 
 * Genera scripts Python para Blender que visualizan:
 * - Redes de sensores ternarias en 3D
 * - Mapas de calor de distribución de trits
 * - Animaciones de propagación de ondas
 * - Árboles de decisión ternarios
 * - Lattice Gas Automata en 3D
 * 
 * Uso: ./blender_ternary <tipo> [opciones] > script.py
 *      blender --background --python script.py
 */

#include <stdio.h>
#include <stdlib.h>
#include <string.h>
#include <math.h>
#include <time.h>

/* Generate Blender Python script for sensor network visualization */
void gen_sensor_network(int n_nodes, float area_size) {
    printf("#!/usr/bin/env python3\n");
    printf("# Blender Python Script — Ternary Sensor Network 3D\n");
    printf("# Generated by tritos_science blender command\n\n");
    
    printf("import bpy\n");
    printf("import bmesh\n");
    printf("from mathutils import Vector\n");
    printf("import random\n\n");
    
    printf("# Clear scene\n");
    printf("bpy.ops.object.select_all(action='SELECT')\n");
    printf("bpy.ops.object.delete()\n\n");
    
    printf("random.seed(42)\n\n");
    
    /* Create sensor nodes */
    printf("# Create sensor nodes\n");
    for (int i = 0; i < n_nodes; i++) {
        float x = (float)rand() / RAND_MAX * area_size;
        float y = (float)rand() / RAND_MAX * area_size;
        float z = ((float)rand() / RAND_MAX - 0.5) * 10;
        
        /* Random ternary state */
        int state = (rand() % 3) - 1;
        
        /* Color based on state */
        float r, g, b;
        if (state == -1) { r = 0.2; g = 0.4; b = 0.8; }      /* Blue: low */
        else if (state == 0) { r = 0.8; g = 0.8; b = 0.2; }   /* Yellow: neutral */
        else { r = 0.8; g = 0.2; b = 0.2; }                    /* Red: high */
        
        printf("bpy.ops.mesh.primitive_uv_sphere_add(radius=0.5, location=(%.2f, %.2f, %.2f))\n", x, y, z);
        printf("node_%d = bpy.context.active_object\n", i);
        printf("node_%d.name = 'Sensor_%d'\n", i, i);
        printf("mat_%d = bpy.data.materials.new(name='mat_%d')\n", i, i);
        printf("mat_%d.diffuse_color = (%.2f, %.2f, %.2f, 1.0)\n", i, r, g, b);
        printf("node_%d.data.materials.append(mat_%d)\n\n", i, i);
    }
    
    /* Create connections between nearby nodes */
    printf("# Create connections\n");
    for (int i = 0; i < n_nodes; i++) {
        for (int j = i + 1; j < n_nodes; j++) {
            if ((float)rand() / RAND_MAX < 0.3) {  /* 30% connection probability */
                printf("bpy.ops.mesh.primitive_cylinder_add(radius=0.05, depth=1, location=(0, 0, 0))\n");
                printf("conn_%d_%d = bpy.context.active_object\n", i, j);
                printf("conn_%d_%d.name = 'Connection_%d_%d'\n", i, j, i, j);
                
                /* Create line between nodes */
                printf("bpy.ops.object.mode_set(mode='EDIT')\n");
                printf("bm = bmesh.from_edit_mesh(conn_%d_%d.data)\n", i, j);
                printf("bm.clear()\n");
                printf("v1 = bm.verts.new((%.2f, %.2f, 0))\n", 
                       (float)rand() / RAND_MAX * area_size,
                       (float)rand() / RAND_MAX * area_size);
                printf("v2 = bm.verts.new((%.2f, %.2f, 0))\n",
                       (float)rand() / RAND_MAX * area_size,
                       (float)rand() / RAND_MAX * area_size);
                printf("bm.edges.new((v1, v2))\n");
                printf("bpy.ops.object.mode_set(mode='OBJECT')\n\n");
            }
        }
    }
    
    /* Add camera and light */
    printf("# Add camera and light\n");
    printf("bpy.ops.object.camera_add(location=(%.0f, %.0f, %.0f))\n", 
           area_size / 2, -area_size, area_size);
    printf("cam = bpy.context.active_object\n");
    printf("cam.rotation_euler = (1.0, 0, 0.8)\n\n");
    
    printf("bpy.ops.object.light_add(type='SUN', location=(0, 0, 100))\n\n");
    
    printf("# Set render settings\n");
    printf("bpy.context.scene.render.engine = 'BLENDER_EEVEE'\n");
    printf("bpy.context.scene.render.resolution_x = 1920\n");
    printf("bpy.context.scene.render.resolution_y = 1080\n");
    printf("bpy.ops.render.render(write_still=True)\n");
}

/* Generate LGA 3D visualization */
void gen_lga_3d(int width, int height, int steps) {
    printf("#!/usr/bin/env python3\n");
    printf("# Blender Python Script — Lattice Gas Automata 3D\n\n");
    
    printf("import bpy\n");
    printf("import random\n\n");
    
    printf("bpy.ops.object.select_all(action='SELECT')\n");
    printf("bpy.ops.object.delete()\n\n");
    
    printf("random.seed(42)\n\n");
    
    /* Create lattice nodes */
    printf("# Create lattice\n");
    for (int y = 0; y < height; y++) {
        for (int x = 0; x < width; x++) {
            int state = (rand() % 3) - 1;
            float scale = 0.3 + abs(state) * 0.2;
            
            printf("bpy.ops.mesh.primitive_uv_sphere_add(radius=%.2f, location=(%d, %d, 0))\n",
                   scale, x * 2, y * 2);
            printf("node_%d_%d = bpy.context.active_object\n", x, y);
            
            if (state == -1) {
                printf("mat = bpy.data.materials.new(name='empty_%d_%d')\n", x, y);
                printf("mat.diffuse_color = (0.1, 0.1, 0.3, 0.5)\n");
            } else if (state == 0) {
                printf("mat = bpy.data.materials.new(name='slow_%d_%d')\n", x, y);
                printf("mat.diffuse_color = (0.2, 0.6, 0.2, 0.8)\n");
            } else {
                printf("mat = bpy.data.materials.new(name='fast_%d_%d')\n", x, y);
                printf("mat.diffuse_color = (0.8, 0.2, 0.2, 1.0)\n");
            }
            printf("node_%d_%d.data.materials.append(mat)\n\n", x, y);
        }
    }
    
    printf("bpy.ops.object.camera_add(location=(%d, %d, %d))\n",
           width, -height * 2, height * 2);
    printf("bpy.ops.object.light_add(type='SUN', location=(0, 0, 50))\n");
}

/* Generate Ising model visualization */
void gen_ising_3d(int width, int height) {
    printf("#!/usr/bin/env python3\n");
    printf("# Blender Python Script — Ising Ternary Model 3D\n\n");
    
    printf("import bpy\n");
    printf("import random\n\n");
    
    printf("bpy.ops.object.select_all(action='SELECT')\n");
    printf("bpy.ops.object.delete()\n\n");
    
    printf("random.seed(42)\n\n");
    
    printf("# Create spin lattice\n");
    for (int y = 0; y < height; y++) {
        for (int x = 0; x < width; x++) {
            int spin = (rand() % 3) - 1;
            
            /* Arrow pointing up/down/neutral */
            float z_scale = spin * 0.5;
            
            printf("bpy.ops.mesh.primitive_cone_add(radius1=0.3, radius2=0, depth=1, location=(%d, %d, %.2f))\n",
                   x * 2, y * 2, z_scale);
            printf("spin_%d_%d = bpy.context.active_object\n", x, y);
            
            if (spin == -1) {
                printf("mat = bpy.data.materials.new(name='down_%d_%d')\n", x, y);
                printf("mat.diffuse_color = (0.2, 0.2, 0.8, 1.0)\n");
            } else if (spin == 0) {
                printf("mat = bpy.data.materials.new(name='neutral_%d_%d')\n", x, y);
                printf("mat.diffuse_color = (0.8, 0.8, 0.2, 1.0)\n");
            } else {
                printf("mat = bpy.data.materials.new(name='up_%d_%d')\n", x, y);
                printf("mat.diffuse_color = (0.8, 0.2, 0.2, 1.0)\n");
            }
            printf("spin_%d_%d.data.materials.append(mat)\n\n", x, y);
        }
    }
    
    printf("bpy.ops.object.camera_add(location=(%d, %d, %d))\n",
           width, -height * 2, height * 2);
    printf("bpy.ops.object.light_add(type='SUN', location=(0, 0, 50))\n");
}

/* Generate wave propagation animation */
void gen_wave_animation(int width, int height, int frames) {
    printf("#!/usr/bin/env python3\n");
    printf("# Blender Python Script — Wave Propagation Animation\n\n");
    
    printf("import bpy\n");
    printf("import math\n\n");
    
    printf("bpy.ops.object.select_all(action='SELECT')\n");
    printf("bpy.ops.object.delete()\n\n");
    
    printf("# Create grid\n");
    printf("grid = []\n");
    for (int y = 0; y < height; y++) {
        printf("row = []\n");
        for (int x = 0; x < width; x++) {
            printf("bpy.ops.mesh.primitive_uv_sphere_add(radius=0.4, location=(%d, %d, 0))\n",
                   x * 2, y * 2);
            printf("obj = bpy.context.active_object\n");
            printf("obj.name = 'node_%d_%d'\n", x, y);
            printf("mat = bpy.data.materials.new(name='wave_%d_%d')\n", x, y);
            printf("mat.diffuse_color = (0.2, 0.2, 0.8, 1.0)\n");
            printf("obj.data.materials.append(mat)\n");
            printf("row.append(obj)\n");
        }
        printf("grid.append(row)\n");
    }
    
    printf("\n# Animate wave propagation\n");
    printf("for frame in range(%d):\n", frames);
    printf("    bpy.context.scene.frame_set(frame)\n");
    printf("    for y in range(%d):\n", height);
    printf("        for x in range(%d):\n", width);
    printf("            dist = math.sqrt((x - %d/2)**2 + (y - %d/2)**2)\n", width, height);
    printf("            wave = math.sin(dist - frame * 0.2) * 0.5\n");
    printf("            grid[y][x].location.z = wave\n");
    printf("            r = 0.5 + wave * 0.5\n");
    printf("            b = 0.5 - wave * 0.5\n");
    printf("            grid[y][x].data.materials[0].diffuse_color = (r, 0.2, b, 1.0)\n");
    printf("            grid[y][x].keyframe_insert(data_path='location', index=2, frame=frame)\n\n");
    
    printf("bpy.context.scene.frame_start = 0\n");
    printf("bpy.context.scene.frame_end = %d\n", frames);
    printf("bpy.ops.object.camera_add(location=(%d, %d, %d))\n",
           width, -height * 2, height * 2);
    printf("bpy.ops.object.light_add(type='SUN', location=(0, 0, 50))\n");
}

/* Generate heatmap visualization */
void gen_heatmap(int width, int height) {
    printf("#!/usr/bin/env python3\n");
    printf("# Blender Python Script — Heatmap Visualization\n\n");
    
    printf("import bpy\n");
    printf("import random\n\n");
    
    printf("bpy.ops.object.select_all(action='SELECT')\n");
    printf("bpy.ops.object.delete()\n\n");
    
    printf("random.seed(42)\n\n");
    
    printf("# Create heatmap grid\n");
    for (int y = 0; y < height; y++) {
        for (int x = 0; x < width; x++) {
            float value = (float)rand() / RAND_MAX;
            
            /* Color gradient: blue -> green -> yellow -> red */
            float r, g, b;
            if (value < 0.25) {
                r = 0; g = value * 4; b = 1;
            } else if (value < 0.5) {
                r = 0; g = 1; b = 1 - (value - 0.25) * 4;
            } else if (value < 0.75) {
                r = (value - 0.5) * 4; g = 1; b = 0;
            } else {
                r = 1; g = 1 - (value - 0.75) * 4; b = 0;
            }
            
            printf("bpy.ops.mesh.primitive_plane_add(size=1.8, location=(%d, %d, 0))\n",
                   x * 2, y * 2);
            printf("cell_%d_%d = bpy.context.active_object\n", x, y);
            printf("mat_%d_%d = bpy.data.materials.new(name='heat_%d_%d')\n", x, y, x, y);
            printf("mat_%d_%d.diffuse_color = (%.2f, %.2f, %.2f, 1.0)\n", x, y, r, g, b);
            printf("cell_%d_%d.data.materials.append(mat_%d_%d)\n\n", x, y, x, y);
        }
    }
    
    printf("bpy.ops.object.camera_add(location=(%d, %d, %d))\n",
           width, -height, (width > height ? width : height) * 2);
    printf("bpy.context.active_object.rotation_euler = (0, 0, 0)\n");
    printf("bpy.ops.object.light_add(type='SUN', location=(0, 0, 50))\n");
}

/* Print help */
void print_blender_help() {
    printf("Tritos Science — Blender 3D Visualization\n");
    printf("==========================================\n\n");
    printf("Usage: blender_ternary <type> [options] > script.py\n");
    printf("       blender --background --python script.py\n\n");
    printf("Types:\n");
    printf("  sensor    - Sensor network 3D visualization\n");
    printf("  lga       - Lattice Gas Automata 3D\n");
    printf("  ising     - Ising model spin lattice 3D\n");
    printf("  wave      - Wave propagation animation\n");
    printf("  heatmap   - Heatmap visualization\n\n");
    printf("Options:\n");
    printf("  -n <int>    Number of nodes/width (default: 8)\n");
    printf("  -m <int>    Height (default: 8)\n");
    printf("  -s <int>    Steps/frames (default: 100)\n");
    printf("  -a <float>  Area size (default: 100)\n");
}

int blender_main(int argc, char* argv[]) {
    int n = 8, m = 8, steps = 100;
    float area = 100.0;
    char* type = NULL;
    
    for (int i = 1; i < argc; i++) {
        if (argv[i][0] != '-') {
            type = argv[i];
        } else if (strcmp(argv[i], "-n") == 0 && i + 1 < argc) {
            n = atoi(argv[++i]);
        } else if (strcmp(argv[i], "-m") == 0 && i + 1 < argc) {
            m = atoi(argv[++i]);
        } else if (strcmp(argv[i], "-s") == 0 && i + 1 < argc) {
            steps = atoi(argv[++i]);
        } else if (strcmp(argv[i], "-a") == 0 && i + 1 < argc) {
            area = atof(argv[++i]);
        } else if (strcmp(argv[i], "-h") == 0) {
            print_blender_help();
            return 0;
        }
    }
    
    if (!type) {
        print_blender_help();
        return 1;
    }
    
    srand(time(NULL));
    
    if (strcmp(type, "sensor") == 0) {
        gen_sensor_network(n, area);
    } else if (strcmp(type, "lga") == 0) {
        gen_lga_3d(n, m, steps);
    } else if (strcmp(type, "ising") == 0) {
        gen_ising_3d(n, m);
    } else if (strcmp(type, "wave") == 0) {
        gen_wave_animation(n, m, steps);
    } else if (strcmp(type, "heatmap") == 0) {
        gen_heatmap(n, m);
    } else {
        fprintf(stderr, "Unknown type: %s\n", type);
        print_blender_help();
        return 1;
    }
    
    return 0;
}
